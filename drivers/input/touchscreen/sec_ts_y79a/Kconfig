## drivers/input/touchscreen/sec_ts_y79a/Kconfig
```kconfig
config TOUCHSCREEN_SEC_TS_Y79A
	bool "Samsung SEC_TS Y79A touchscreen (Exynos 990 x1s/y2s/z3s, 4.19 driver)"
	depends on I2C && SOC_EXYNOS9830
	help
	  Touch controller of the Galaxy S20 series, with the 4.19 sec_cmd and
	  TCLM support it was written against.
```

## drivers/iommu/exynos990/Kconfig
```kconfig
# SPDX-License-Identifier: GPL-2.0-only
config EXYNOS990_IOMMU
	bool "Exynos 990 System MMU (4.19 driver)"
	depends on SOC_EXYNOS9830 && ARM64
	select IOMMU_API
	help
	  System MMU v7 driver of the Exynos 990 4.19 BSP. Its multimedia
	  masters (DPU, G2D, MSCL, ...) map buffers through the IOVMM API
	  below rather than through the DMA API.

config EXYNOS_IOVMM
	bool "IO Virtual Memory Manager for the Exynos 990 System MMU"
	depends on EXYNOS990_IOMMU
	default y
```

## drivers/media/platform/exynos/mfc990/Kconfig
```kconfig
config VIDEO_EXYNOS990_MFC
	bool "Exynos 990 MFC driver (4.19)"
	depends on SOC_EXYNOS9830 && EXYNOS_IOVMM
	select VIDEOBUF2_CORE
	select VIDEOBUF2_DMA_SG
	help
	  MFC video codec of Exynos 990 for the 4.19-era Codec2/OMX vendor HALs.
	  The 5.15 mfc driver is for the newer core/ctx MFC.
```
